## configs/rpi3b-banking_defconfig
```kconfig
BR2_arm=y
BR2_cortex_a53=y
BR2_ARM_FPU_NEON_VFPV4=y
BR2_GLOBAL_PATCH_DIR="$(TOPDIR)/patches"
BR2_PACKAGE_HOST_LINUX_HEADERS_CUSTOM_4_9=y
BR2_TOOLCHAIN_BUILDROOT_WCHAR=y
BR2_PTHREAD_DEBUG=y
BR2_TOOLCHAIN_BUILDROOT_CXX=y
BR2_PACKAGE_HOST_GDB=y
BR2_PACKAGE_HOST_GDB_PYTHON=y
BR2_ROOTFS_DEVICE_CREATION_DYNAMIC_MDEV=y
BR2_SYSTEM_DHCP="eth0"
BR2_ROOTFS_USERS_TABLES="board/raspberrypi3/users"
BR2_ROOTFS_OVERLAY="$(TOPDIR)/board/raspberrypi3/overlay_banking"
BR2_ROOTFS_POST_BUILD_SCRIPT="board/raspberrypi3/post-build.sh board/raspberrypi3/create-toolch.sh"
BR2_ROOTFS_POST_IMAGE_SCRIPT="board/raspberrypi3/post-image.sh"
BR2_ROOTFS_POST_SCRIPT_ARGS="--add-pi3-miniuart-bt-overlay"
BR2_LINUX_KERNEL=y
BR2_LINUX_KERNEL_CUSTOM_GIT=y
BR2_LINUX_KERNEL_CUSTOM_REPO_URL="https://github.com/raspberrypi/linux.git"
BR2_LINUX_KERNEL_CUSTOM_REPO_VERSION="33ee56d5927ceff630fbc87e3f5caa409b6ae114"
BR2_LINUX_KERNEL_DEFCONFIG="bcm2709"
BR2_LINUX_KERNEL_DTS_SUPPORT=y
BR2_LINUX_KERNEL_INTREE_DTS_NAME="bcm2710-rpi-3-b bcm2710-rpi-cm3"
BR2_PACKAGE_GDB=y
BR2_PACKAGE_GDB_SERVER=y
BR2_PACKAGE_GDB_DEBUGGER=y
BR2_PACKAGE_GDB_PYTHON=y
BR2_PACKAGE_LIBTOOL=y
BR2_PACKAGE_MESA3D=y
BR2_PACKAGE_MESA3D_GALLIUM_DRIVER_VC4=y
BR2_PACKAGE_MESA3D_OPENGL_ES=y
BR2_PACKAGE_QT5=y
BR2_PACKAGE_QT5BASE_GUI=y
BR2_PACKAGE_QT5BASE_WIDGETS=y
BR2_PACKAGE_QT5BASE_LINUXFB=y
BR2_PACKAGE_QT5BASE_EGLFS=y
BR2_PACKAGE_RPI_FIRMWARE=y
BR2_PACKAGE_RPI_WIFI_FIRMWARE=y
BR2_PACKAGE_PYTHON=y
BR2_PACKAGE_GNUTLS=y
BR2_PACKAGE_LIBXSLT=y
BR2_PACKAGE_TINYXML2=y
BR2_PACKAGE_LIBICONV=y
BR2_PACKAGE_GWENHYWFAR=y
BR2_PACKAGE_KTOBLZCHECK=y
BR2_PACKAGE_XMLSEC1=y
BR2_PACKAGE_AQBANKING=y
BR2_PACKAGE_CRDA=y
BR2_PACKAGE_HOSTAPD=y
BR2_PACKAGE_HOSTAPD_EAP=y
BR2_PACKAGE_HOSTAPD_WPS=y
BR2_PACKAGE_IW=y
BR2_PACKAGE_OPENSSH=y
BR2_PACKAGE_WPA_SUPPLICANT=y
BR2_PACKAGE_WPA_SUPPLICANT_AP_SUPPORT=y
BR2_PACKAGE_WPA_SUPPLICANT_WPS=y
BR2_PACKAGE_WPA_SUPPLICANT_CLI=y
BR2_TARGET_ROOTFS_EXT2=y
BR2_TARGET_ROOTFS_EXT2_4=y
BR2_TARGET_ROOTFS_EXT2_SIZE="140M"
# BR2_TARGET_ROOTFS_TAR is not set
BR2_PACKAGE_HOST_DOSFSTOOLS=y
BR2_PACKAGE_HOST_GENIMAGE=y
BR2_PACKAGE_HOST_MTOOLS=y
```

## package/michael/Config.in
```kconfig
source "package/michael/gwenhywfar/Config.in"
source "package/michael/ktoblzcheck/Config.in"
source "package/michael/xmlsec1/Config.in"
source "package/michael/aqbanking/Config.in"
source "package/michael/scantailor/Config.in"
```

## package/michael/aqbanking/Config.in
```kconfig
config BR2_PACKAGE_AQBANKING
        bool "aqbanking"
	depends on BR2_PACKAGE_GWENHYWFAR
	depends on BR2_PACKAGE_KTOBLZCHECK
	depends on BR2_PACKAGE_XMLSEC1
      
	help
          Library for banking

          https://www.aquamaniac.de
```

## package/michael/gwenhywfar/Config.in
```kconfig
config BR2_PACKAGE_GWENHYWFAR
	bool "gwenhywfar"
	depends on BR2_PACKAGE_GNUTLS
	depends on BR2_PACKAGE_LIBGCRYPT
	help
	  Package needed for aqbanking

	  https://www.aquamaniac.de
```

## package/michael/ktoblzcheck/Config.in
```kconfig
config BR2_PACKAGE_KTOBLZCHECK
        bool "ktoblzcheck"
	depends on BR2_PACKAGE_GWENHYWFAR
        help
          Package needed for aqbanking

          https://sourceforge.net/projects/ktoblzcheck
```

## package/michael/scantailor/Config.in
```kconfig
config BR2_PACKAGE_SCANTAILOR
        bool "scantailor"
      
	help
          Scan Tailor is an interactive post-processing tool for scanned pages.

          http://scantailor.org/
```

## package/michael/xmlsec1/Config.in
```kconfig
config BR2_PACKAGE_XMLSEC1
	bool "xmlsec"
	depends on BR2_PACKAGE_LIBXML2
	depends on BR2_PACKAGE_LIBTOOL
	depends on BR2_PACKAGE_LIBXSLT
	help
	  XML Security Library is a C library based on LibXML2. 

	  https://www.aleksey.com
```
